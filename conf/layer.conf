## conf/layer.conf
```bitbake
# We have a conf and classes directory, append to BBPATH
BBPATH .= ":${LAYERDIR}"

# We have a recipes directory, add to BBFILES
BBFILES += "${LAYERDIR}/recipes-*/*/*.bb ${LAYERDIR}/recipes-*/*/*.bbappend"

BBFILE_COLLECTIONS += "display-layer"
BBFILE_PATTERN_display-layer := "^${LAYERDIR}/"
BBFILE_PRIORITY_display-layer = "7"

LAYERVERSION_display-layer = "1"
LAYERSERIES_COMPAT_display-layer = "kirkstone langdale mickledore"

LAYERDEPENDS_display-layer = "core openembedded-layer raspberrypi"
```
